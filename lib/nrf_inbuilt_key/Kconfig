## lib/nrf_inbuilt_key/Kconfig
```kconfig
#
# Copyright (c) 2019 Nordic Semiconductor
#
# SPDX-License-Identifier: LicenseRef-BSD-5-Clause-Nordic
#

menuconfig NRF_INBUILT_KEY
	bool "nRF9160 inbuilt key library"
	select AT_CMD
	select AT_CMD_PARSER
	select BSD_LIBRARY
	default n
```
